## module/Kconfig
```kconfig
config CHARYBDIS_VBUS_POWER
    bool "Use nRF52840 VBUS for RGB idle and sleep control on both halves"
    depends on SOC_NRF52840 && ZMK_RGB_UNDERGLOW
    help
      USB power prevents RGB idle shutoff and deep sleep. On battery,
      the normal ZMK idle and sleep timeouts apply. Manual RGB on/off
      and saved lighting settings are preserved.
```
